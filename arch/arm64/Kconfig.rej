## arch/arm64/Kconfig.rej
```kconfig
--- arch/arm64/Kconfig
+++ arch/arm64/Kconfig
@@ -670,4 +670,5 @@ endif
 
 source "lib/Kconfig"
 source "arch/arm64/hotplug/autosmp/Kconfig"
+source "arch/arm64/hotplug/Kconfig"
 
```

## arch/arm64/hotplug/Kconfig
```kconfig
config MAKO_HOTPLUG
 	bool "Mako Hotplug"
 	default n
 	help
 	  Mako Hotplug: A custom hotplug MOD by fransico franco

config ALUCARD_HOTPLUG
	bool "Enable alucard-hotplug cpu hotplug driver"
	default n
	help
	  Generic Alucard-hotplug cpu hotplug driver for ARM SOCs

config INTELLI_HOTPLUG
        bool "Enable intelli-plug cpu hotplug driver"
        default n
        help
          Generic Intelli-plug cpu hotplug driver for ARM SOCs

config THUNDERPLUG_CONTROL
	bool "Enable plugging down/up of cores based on load per core"
	default n
	help
	  This driver hotplugs cpu cores based on per-core load

config BLU_HOTPLUG
        default n

config INTELLI_HOTPLUG
        default n

config LAZY_HOTPLUG
        default n
```

## drivers/cpufreq/Kconfig.rej
```kconfig
--- drivers/cpufreq/Kconfig
+++ drivers/cpufreq/Kconfig
@@ -120,6 +120,15 @@ config CPU_FREQ_DEFAULT_GOV_SCHED
 	  cpu frequency using CPU utilization estimates from the
 	  scheduler.
 
+config CPU_FREQ_DEFAULT_GOV_BLU_ACTIVE
+	bool "blu_active"
+	select CPU_FREQ_GOV_BLU_ACTIVE
+	help
+	  Use the CPUFreq governor 'blu_active' as default. This allows
+	  you to get a full dynamic cpu frequency capable system by simply
+	  loading your cpufreq low-level hardware driver, using the
+	  'interactive' governor for latency-sensitive workloads.
+
 endchoice
 
 config CPU_FREQ_GOV_PERFORMANCE
@@ -246,6 +255,21 @@ config CPUFREQ_DT
 
 	  If in doubt, say N.
 
+config CPU_FREQ_GOV_BLU_ACTIVE
+	tristate "'blu_active' cpufreq policy governor"
+	help
+	  'blu_active' - This driver adds a dynamic cpufreq policy governor
+	  designed for latency-sensitive workloads.
+
+	  This governor attempts to reduce the latency of clock
+	  increases so that the system is more responsive to
+	  interactive workloads.
+
+	  To compile this driver as a module, choose M here: the
+	  module will be called cpufreq_blu_active.
+
+	  If in doubt, say N.
+
 config FINGERPRINT_BOOST
  	bool "Fingerprint Boost"
  	default y
```

## drivers/huawei_platform/power/charger/Kconfig.rej
```kconfig
--- drivers/huawei_platform/power/charger/Kconfig
+++ drivers/huawei_platform/power/charger/Kconfig
@@ -3,4 +3,8 @@ source "drivers/huawei_platform/power/charger/charger_sensorhub/Kconfig"
 
 config HUAWEI_CHARGER
 	bool "huawei charger"
-	default n+	default n
+
+config ADVANCED_CHARGE_CONTROL
+	bool "advanced charge control features"
+	default n
```
